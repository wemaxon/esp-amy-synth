## components/esp-pocket-audio/Kconfig.projbuild
```kconfig
menu "ESP Pocket Audio Board"

config AUDIO_BOARD_ESP_POCKET_AUDIO
    bool "Use esp-pocket-audio board implementation"
    depends on AUDIO_BOARD_CUSTOM
    default y
    help
        Use the custom esp-pocket-audio board component. It keeps the
        ESP32-A1S/ES8388 audio wiring from the AI Thinker board and adds a
        separate I2C input bus for ADS1115 analog inputs and PCF8574 switch
        expanders.

endmenu
```

## components/hil_console/Kconfig
```kconfig
menu "Hardware-in-the-loop console"

    config HIL_CONSOLE
        bool "Command console for hardware tests"
        default n
        depends on ESP_CONSOLE_USB_SERIAL_JTAG
        help
            Test builds only (sdkconfig.test, tools/hil.py). A line-based
            command console on the USB-Serial-JTAG console with JSON replies.

endmenu
```

## components/my-synth-v1/Kconfig.projbuild
```kconfig
menu "My Synth V1 Board"

config AUDIO_BOARD_MY_SYNTH_V1
    bool "Use my-synth-v1 board implementation"
    depends on AUDIO_BOARD_CUSTOM
    default y
    help
        Use the custom my-synth-v1 board component. It keeps the
        ESP32-A1S/ES8388 audio wiring from the AI Thinker board and adds a
        separate I2C input bus for ADS1115 analog inputs and PCF8574 switch
        expanders.

endmenu
```

## main/Kconfig.projbuild
```kconfig
menu "ESP Pocket Audio"

    choice ESP_POCKET_AUDIO_BOARD
        prompt "Board configuration"
        default ESP_POCKET_AUDIO_BOARD_WT0132P4_A1 if IDF_TARGET_ESP32P4
        default ESP_POCKET_AUDIO_BOARD_AI_THINKER_A1S
        help
            Select the board-specific hardware configuration header used by the
            firmware.

        config ESP_POCKET_AUDIO_BOARD_AI_THINKER_A1S
            bool "AI Thinker A1S"
            depends on IDF_TARGET_ESP32
            help
                Original ESP32 AI Thinker A1S board configuration.

        config ESP_POCKET_AUDIO_BOARD_WT0132P4_A1
            bool "WT0132P4-A1"
            depends on IDF_TARGET_ESP32P4
            help
                ESP32-P4 WT0132P4-A1 board configuration.

    endchoice

endmenu
```

## sdkconfig.defaults
```kconfig
#
# Log Level
#
CONFIG_LOG_DEFAULT_LEVEL_INFO=y
CONFIG_LOG_DEFAULT_LEVEL=3
CONFIG_LOG_MAXIMUM_LEVEL_VERBOSE=y
CONFIG_LOG_MAXIMUM_LEVEL=5

#
# Partition Table
#
CONFIG_PARTITION_TABLE_CUSTOM=y
CONFIG_PARTITION_TABLE_OFFSET=0x8000

#
# FreeRTOS
#
CONFIG_ESP_SYSTEM_EVENT_TASK_STACK_SIZE=3072
CONFIG_FREERTOS_HZ=1000

#
# Compiler options
#
CONFIG_COMPILER_OPTIMIZATION_PERF=y
```

## sdkconfig.defaults.esp32
```kconfig
#
# Serial flasher config
#
CONFIG_ESPTOOLPY_FLASHMODE_QIO=y
CONFIG_ESPTOOLPY_FLASHFREQ_80M=y
CONFIG_ESPTOOLPY_FLASHSIZE_4MB=y

#
# ESP System Settings
#
CONFIG_ESP_DEFAULT_CPU_FREQ_MHZ_240=y

#
# ESP PSRAM
#
CONFIG_SPIRAM=y
CONFIG_SPIRAM_SPEED_80M=y
```

## sdkconfig.defaults.esp32p4
```kconfig
#
# Chip revision
#
CONFIG_ESP32P4_SELECTS_REV_LESS_V3=y
CONFIG_ESP32P4_REV_MIN_100=y

#
# Serial flasher config
#
CONFIG_ESPTOOLPY_FLASHMODE_QIO=y
CONFIG_ESPTOOLPY_FLASHFREQ_80M=y
CONFIG_ESPTOOLPY_FLASHSIZE_16MB=y

#
# ESP PSRAM
#
CONFIG_SPIRAM=y
```
